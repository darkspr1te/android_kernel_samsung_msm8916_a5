/* Copyright (c) 2013, The Linux Foundation. All rights reserved.
 *
 * This program is free software; you can redistribute it and/or modify
 * it under the terms of the GNU General Public License version 2 and
 * only version 2 as published by the Free Software Foundation.
 *
 * This program is distributed in the hope that it will be useful,
 * but WITHOUT ANY WARRANTY; without even the implied warranty of
 * MERCHANTABILITY or FITNESS FOR A PARTICULAR PURPOSE.  See the
 * GNU General Public License for more details.
 */

/*---------------------------------------------------------------------------
 * This file is autogenerated file using gcdb parser. Please do not edit it.
 * Update input XML file to add a new entry or update variable in this file
 * VERSION = "1.0"
 *---------------------------------------------------------------------------*/
&mdss_mdp {
	dsi_nt35592_720_vid: qcom,mdss_dsi_nt35592_720p_video {
		qcom,mdss-dsi-panel-name = "nt35592 720p video mode dsi panel";
		qcom,mdss-dsi-panel-controller = <&mdss_dsi0>;
		qcom,mdss-dsi-panel-type = "dsi_video_mode";
		qcom,mdss-dsi-panel-destination = "display_1";
		qcom,mdss-dsi-panel-framerate = <60>;
		qcom,mdss-dsi-virtual-channel-id = <0>;
		qcom,mdss-dsi-stream = <0>;
		qcom,mdss-dsi-panel-width = <720>;
		qcom,mdss-dsi-panel-height = <1280>;
		qcom,mdss-dsi-h-front-porch = <72>;
		qcom,mdss-dsi-h-back-porch = <84>;
		qcom,mdss-dsi-h-pulse-width = <16>;
		qcom,mdss-dsi-h-sync-skew = <0>;
		qcom,mdss-dsi-v-back-porch = <20>;
		qcom,mdss-dsi-v-front-porch = <9>;
		qcom,mdss-dsi-v-pulse-width = <2>;
		qcom,mdss-dsi-h-left-border = <0>;
		qcom,mdss-dsi-h-right-border = <0>;
		qcom,mdss-dsi-v-top-border = <0>;
		qcom,mdss-dsi-v-bottom-border = <0>;
		qcom,mdss-dsi-bpp = <24>;
		qcom,mdss-dsi-underflow-color = <0xff>;
		qcom,mdss-dsi-border-color = <0>;
		qcom,mdss-dsi-on-command = [
			/* < Power Setting (1) > */
			15 00 00 00 00 00 02 FF 01
			15 00 00 00 00 00 02 FB 01
			15 00 00 00 00 00 02 00 3A
			15 00 00 00 00 00 02 08 66
			15 00 00 00 00 00 02 09 8F
			15 00 00 00 00 00 02 0B C2
			15 00 00 00 00 00 02 0C C2
			15 00 00 00 00 00 02 0D 25
			15 00 00 00 00 00 02 0E 33
			15 00 00 00 00 00 02 71 2C
			15 00 00 00 00 00 02 0F 0A
			15 00 00 00 00 00 02 36 73
			15 00 00 00 00 00 02 68 03
			15 01 00 00 00 00 02 4B 00

			/* < Timing Setting(2) > */
			15 00 00 00 00 00 02 FF 05
			15 00 00 00 00 00 02 FB 01
			15 00 00 00 00 00 02 01 00
			15 00 00 00 00 00 02 02 8D
			15 00 00 00 00 00 02 03 8D
			15 00 00 00 00 00 02 04 8D
			15 00 00 00 00 00 02 05 30
			15 00 00 00 00 00 02 06 33
			15 00 00 00 00 00 02 07 77
			15 00 00 00 00 00 02 08 00
			15 00 00 00 00 00 02 09 00
			15 00 00 00 00 00 02 0A 00
			15 00 00 00 00 00 02 0B 80
			15 00 00 00 00 00 02 0C C8
			15 00 00 00 00 00 02 0D 0A
			15 00 00 00 00 00 02 0E 1B
			15 00 00 00 00 00 02 0F 06
			15 00 00 00 00 00 02 10 56
			15 00 00 00 00 00 02 11 00
			15 00 00 00 00 00 02 12 00
			15 00 00 00 00 00 02 13 1E
			15 00 00 00 00 00 02 14 00
			15 00 00 00 00 00 02 15 1A
			15 00 00 00 00 00 02 16 05
			15 00 00 00 00 00 02 17 00
			15 00 00 00 00 00 02 18 1E
			15 00 00 00 00 00 02 19 FF
			15 00 00 00 00 00 02 1A 00
			15 00 00 00 00 00 02 1B FC
			15 00 00 00 00 00 02 1C 80
			15 00 00 00 00 00 02 1D 00
			15 00 00 00 00 00 02 1E 10
			15 00 00 00 00 00 02 1F 77
			15 00 00 00 00 00 02 20 00
			15 00 00 00 00 00 02 21 00
			15 00 00 00 00 00 02 22 55
			15 00 00 00 00 00 02 23 0D
			15 00 00 00 00 00 02 31 A0
			15 00 00 00 00 00 02 32 00
			15 00 00 00 00 00 02 33 B8
			15 00 00 00 00 00 02 34 BB
			15 00 00 00 00 00 02 35 11
			15 00 00 00 00 00 02 36 02
			15 00 00 00 00 00 02 37 00
			15 00 00 00 00 00 02 38 01
			15 00 00 00 00 00 02 39 0B
			15 00 00 00 00 00 02 44 08
			15 00 00 00 00 00 02 45 80
			15 00 00 00 00 00 02 46 CC
			15 00 00 00 00 00 02 47 04
			15 00 00 00 00 00 02 48 00
			15 00 00 00 00 00 02 49 00
			15 00 00 00 00 00 02 4A 01
			15 00 00 00 00 00 02 6C 03
			15 00 00 00 00 00 02 6D 03
			15 00 00 00 00 00 02 6E 2F
			15 00 00 00 00 00 02 6F 25
			15 00 00 00 00 00 02 43 00
			15 00 00 00 00 00 02 4B 23
			15 00 00 00 00 00 02 4C 01
			15 00 00 00 00 00 02 50 23
			15 00 00 00 00 00 02 51 01
			15 00 00 00 00 00 02 58 23
			15 00 00 00 00 00 02 59 01
			15 00 00 00 00 00 02 5D 23
			15 00 00 00 00 00 02 5E 01
			15 00 00 00 00 00 02 89 C1
			15 00 00 00 00 00 02 8D 01
			15 00 00 00 00 00 02 8E 64
			15 00 00 00 00 00 02 8F 20
			15 00 00 00 00 00 02 97 8E
			15 00 00 00 00 00 02 82 8C
			15 00 00 00 00 00 02 83 02
			15 00 00 00 00 00 02 BB 0A
			15 00 00 00 00 00 02 BC 0A
			15 00 00 00 00 00 02 24 25
			15 00 00 00 00 00 02 25 55
			15 00 00 00 00 00 02 26 05
			15 00 00 00 00 00 02 27 23
			15 00 00 00 00 00 02 28 01
			15 00 00 00 00 00 02 29 31
			15 00 00 00 00 00 02 2A 5D
			15 00 00 00 00 00 02 2B 01
			15 00 00 00 00 00 02 2F 00
			15 00 00 00 00 00 02 30 10
			15 00 00 00 00 00 02 A7 12
			15 01 00 00 00 00 02 2D 03

			/* 3. Gamma Setting(3) */
			15 00 00 00 00 00 02 FF 01
			15 00 00 00 00 00 02 FB 01
			15 00 00 00 00 00 02 75 00
			15 00 00 00 00 00 02 76 80
			15 00 00 00 00 00 02 77 00
			15 00 00 00 00 00 02 78 9E
			15 00 00 00 00 00 02 79 00
			15 00 00 00 00 00 02 7A C4
			15 00 00 00 00 00 02 7B 00
			15 00 00 00 00 00 02 7C DE
			15 00 00 00 00 00 02 7D 00
			15 00 00 00 00 00 02 7E F5
			15 00 00 00 00 00 02 7F 01
			15 00 00 00 00 00 02 80 07
			15 00 00 00 00 00 02 81 01
			15 00 00 00 00 00 02 82 17
			15 00 00 00 00 00 02 83 01
			15 00 00 00 00 00 02 84 25
			15 00 00 00 00 00 02 85 01
			15 00 00 00 00 00 02 86 32
			15 00 00 00 00 00 02 87 01
			15 00 00 00 00 00 02 88 5D
			15 00 00 00 00 00 02 89 01
			15 00 00 00 00 00 02 8A 7F
			15 00 00 00 00 00 02 8B 01
			15 00 00 00 00 00 02 8C B4
			15 00 00 00 00 00 02 8D 01
			15 00 00 00 00 00 02 8E DE
			15 00 00 00 00 00 02 8F 02
			15 00 00 00 00 00 02 90 21
			15 00 00 00 00 00 02 91 02
			15 00 00 00 00 00 02 92 56
			15 00 00 00 00 00 02 93 02
			15 00 00 00 00 00 02 94 58
			15 00 00 00 00 00 02 95 02
			15 00 00 00 00 00 02 96 8B
			15 00 00 00 00 00 02 97 02
			15 00 00 00 00 00 02 98 C5
			15 00 00 00 00 00 02 99 02
			15 00 00 00 00 00 02 9A EA
			15 00 00 00 00 00 02 9B 03
			15 00 00 00 00 00 02 9C 1D
			15 00 00 00 00 00 02 9D 03
			15 00 00 00 00 00 02 9E 3E
			15 00 00 00 00 00 02 9F 03
			15 00 00 00 00 00 02 A0 67
			15 00 00 00 00 00 02 A2 03
			15 00 00 00 00 00 02 A3 73
			15 00 00 00 00 00 02 A4 03
			15 00 00 00 00 00 02 A5 7D
			15 00 00 00 00 00 02 A6 03
			15 00 00 00 00 00 02 A7 85
			15 00 00 00 00 00 02 A9 03
			15 00 00 00 00 00 02 AA 8A
			15 00 00 00 00 00 02 AB 03
			15 00 00 00 00 00 02 AC 99
			15 00 00 00 00 00 02 AD 03
			15 00 00 00 00 00 02 AE AA
			15 00 00 00 00 00 02 AF 03
			15 00 00 00 00 00 02 B0 B0
			15 00 00 00 00 00 02 B1 03
			15 00 00 00 00 00 02 B2 B4
			15 00 00 00 00 00 02 B3 00
			15 00 00 00 00 00 02 B4 80
			15 00 00 00 00 00 02 B5 00
			15 00 00 00 00 00 02 B6 9E
			15 00 00 00 00 00 02 B7 00
			15 00 00 00 00 00 02 B8 C4
			15 00 00 00 00 00 02 B9 00
			15 00 00 00 00 00 02 BA DE
			15 00 00 00 00 00 02 BB 00
			15 00 00 00 00 00 02 BC F5
			15 00 00 00 00 00 02 BD 01
			15 00 00 00 00 00 02 BE 07
			15 00 00 00 00 00 02 BF 01
			15 00 00 00 00 00 02 C0 17
			15 00 00 00 00 00 02 C1 01
			15 00 00 00 00 00 02 C2 25
			15 00 00 00 00 00 02 C3 01
			15 00 00 00 00 00 02 C4 32
			15 00 00 00 00 00 02 C5 01
			15 00 00 00 00 00 02 C6 5D
			15 00 00 00 00 00 02 C7 01
			15 00 00 00 00 00 02 C8 7F
			15 00 00 00 00 00 02 C9 01
			15 00 00 00 00 00 02 CA B4
			15 00 00 00 00 00 02 CB 01
			15 00 00 00 00 00 02 CC DE
			15 00 00 00 00 00 02 CD 02
			15 00 00 00 00 00 02 CE 21
			15 00 00 00 00 00 02 CF 02
			15 00 00 00 00 00 02 D0 56
			15 00 00 00 00 00 02 D1 02
			15 00 00 00 00 00 02 D2 58
			15 00 00 00 00 00 02 D3 02
			15 00 00 00 00 00 02 D4 8B
			15 00 00 00 00 00 02 D5 02
			15 00 00 00 00 00 02 D6 C5
			15 00 00 00 00 00 02 D7 02
			15 00 00 00 00 00 02 D8 EA
			15 00 00 00 00 00 02 D9 03
			15 00 00 00 00 00 02 DA 1D
			15 00 00 00 00 00 02 DB 03
			15 00 00 00 00 00 02 DC 3E
			15 00 00 00 00 00 02 DD 03
			15 00 00 00 00 00 02 DE 67
			15 00 00 00 00 00 02 DF 03
			15 00 00 00 00 00 02 E0 73
			15 00 00 00 00 00 02 E1 03
			15 00 00 00 00 00 02 E2 7D
			15 00 00 00 00 00 02 E3 03
			15 00 00 00 00 00 02 E4 85
			15 00 00 00 00 00 02 E5 03
			15 00 00 00 00 00 02 E6 8A
			15 00 00 00 00 00 02 E7 03
			15 00 00 00 00 00 02 E8 99
			15 00 00 00 00 00 02 E9 03
			15 00 00 00 00 00 02 EA AA
			15 00 00 00 00 00 02 EB 03
			15 00 00 00 00 00 02 EC B0
			15 00 00 00 00 00 02 ED 03
			15 00 00 00 00 00 02 EE B4
			15 00 00 00 00 00 02 EF 01
			15 00 00 00 00 00 02 F0 20
			15 00 00 00 00 00 02 F1 01
			15 00 00 00 00 00 02 F2 26
			15 00 00 00 00 00 02 F3 01
			15 00 00 00 00 00 02 F4 32
			15 00 00 00 00 00 02 F5 01
			15 00 00 00 00 00 02 F6 3C
			15 00 00 00 00 00 02 F7 01
			15 00 00 00 00 00 02 F8 47
			15 00 00 00 00 00 02 F9 01
			15 01 00 00 00 00 02 FA 51

			15 00 00 00 00 00 02 FF 02
			15 00 00 00 00 00 02 FB 01
			15 00 00 00 00 00 02 00 01
			15 00 00 00 00 00 02 01 5A
			15 00 00 00 00 00 02 02 01
			15 00 00 00 00 00 02 03 63
			15 00 00 00 00 00 02 04 01
			15 00 00 00 00 00 02 05 6B
			15 00 00 00 00 00 02 06 01
			15 00 00 00 00 00 02 07 89
			15 00 00 00 00 00 02 08 01
			15 00 00 00 00 00 02 09 A3
			15 00 00 00 00 00 02 0A 01
			15 00 00 00 00 00 02 0B CE
			15 00 00 00 00 00 02 0C 01
			15 00 00 00 00 00 02 0D F2
			15 00 00 00 00 00 02 0E 02
			15 00 00 00 00 00 02 0F 2C
			15 00 00 00 00 00 02 10 02
			15 00 00 00 00 00 02 11 5E
			15 00 00 00 00 00 02 12 02
			15 00 00 00 00 00 02 13 60
			15 00 00 00 00 00 02 14 02
			15 00 00 00 00 00 02 15 91
			15 00 00 00 00 00 02 16 02
			15 00 00 00 00 00 02 17 CA
			15 00 00 00 00 00 02 18 02
			15 00 00 00 00 00 02 19 F0
			15 00 00 00 00 00 02 1A 03
			15 00 00 00 00 00 02 1B 22
			15 00 00 00 00 00 02 1C 03
			15 00 00 00 00 00 02 1D 44
			15 00 00 00 00 00 02 1E 03
			15 00 00 00 00 00 02 1F 6D
			15 00 00 00 00 00 02 20 03
			15 00 00 00 00 00 02 21 70
			15 00 00 00 00 00 02 22 03
			15 00 00 00 00 00 02 23 79
			15 00 00 00 00 00 02 24 03
			15 00 00 00 00 00 02 25 85
			15 00 00 00 00 00 02 26 03
			15 00 00 00 00 00 02 27 93
			15 00 00 00 00 00 02 28 03
			15 00 00 00 00 00 02 29 9E
			15 00 00 00 00 00 02 2A 03
			15 00 00 00 00 00 02 2B A9
			15 00 00 00 00 00 02 2D 03
			15 00 00 00 00 00 02 2F AF
			15 00 00 00 00 00 02 30 03
			15 00 00 00 00 00 02 31 B4
			15 00 00 00 00 00 02 32 01
			15 00 00 00 00 00 02 33 20
			15 00 00 00 00 00 02 34 01
			15 00 00 00 00 00 02 35 26
			15 00 00 00 00 00 02 36 01
			15 00 00 00 00 00 02 37 32
			15 00 00 00 00 00 02 38 01
			15 00 00 00 00 00 02 39 3C
			15 00 00 00 00 00 02 3A 01
			15 00 00 00 00 00 02 3B 47
			15 00 00 00 00 00 02 3D 01
			15 00 00 00 00 00 02 3F 51
			15 00 00 00 00 00 02 40 01
			15 00 00 00 00 00 02 41 5A
			15 00 00 00 00 00 02 42 01
			15 00 00 00 00 00 02 43 63
			15 00 00 00 00 00 02 44 01
			15 00 00 00 00 00 02 45 6B
			15 00 00 00 00 00 02 46 01
			15 00 00 00 00 00 02 47 89
			15 00 00 00 00 00 02 48 01
			15 00 00 00 00 00 02 49 A3
			15 00 00 00 00 00 02 4A 01
			15 00 00 00 00 00 02 4B CE
			15 00 00 00 00 00 02 4C 01
			15 00 00 00 00 00 02 4D F2
			15 00 00 00 00 00 02 4E 02
			15 00 00 00 00 00 02 4F 2C
			15 00 00 00 00 00 02 50 02
			15 00 00 00 00 00 02 51 5E
			15 00 00 00 00 00 02 52 02
			15 00 00 00 00 00 02 53 60
			15 00 00 00 00 00 02 54 02
			15 00 00 00 00 00 02 55 91
			15 00 00 00 00 00 02 56 02
			15 00 00 00 00 00 02 58 CA
			15 00 00 00 00 00 02 59 02
			15 00 00 00 00 00 02 5A F0
			15 00 00 00 00 00 02 5B 03
			15 00 00 00 00 00 02 5C 22
			15 00 00 00 00 00 02 5D 03
			15 00 00 00 00 00 02 5E 44
			15 00 00 00 00 00 02 5F 03
			15 00 00 00 00 00 02 60 6D
			15 00 00 00 00 00 02 61 03
			15 00 00 00 00 00 02 62 70
			15 00 00 00 00 00 02 63 03
			15 00 00 00 00 00 02 64 79
			15 00 00 00 00 00 02 65 03
			15 00 00 00 00 00 02 66 85
			15 00 00 00 00 00 02 67 03
			15 00 00 00 00 00 02 68 93
			15 00 00 00 00 00 02 69 03
			15 00 00 00 00 00 02 6A 9E
			15 00 00 00 00 00 02 6B 03
			15 00 00 00 00 00 02 6C A9
			15 00 00 00 00 00 02 6D 03
			15 00 00 00 00 00 02 6E AF
			15 00 00 00 00 00 02 6F 03
			15 00 00 00 00 00 02 70 B4
			15 00 00 00 00 00 02 71 01
			15 00 00 00 00 00 02 72 40
			15 00 00 00 00 00 02 73 01
			15 00 00 00 00 00 02 74 45
			15 00 00 00 00 00 02 75 01
			15 00 00 00 00 00 02 76 4E
			15 00 00 00 00 00 02 77 01
			15 00 00 00 00 00 02 78 58
			15 00 00 00 00 00 02 79 01
			15 00 00 00 00 00 02 7A 60
			15 00 00 00 00 00 02 7B 01
			15 00 00 00 00 00 02 7C 68
			15 00 00 00 00 00 02 7D 01
			15 00 00 00 00 00 02 7E 70
			15 00 00 00 00 00 02 7F 01
			15 00 00 00 00 00 02 80 78
			15 00 00 00 00 00 02 81 01
			15 00 00 00 00 00 02 82 7F
			15 00 00 00 00 00 02 83 01
			15 00 00 00 00 00 02 84 99
			15 00 00 00 00 00 02 85 01
			15 00 00 00 00 00 02 86 B0
			15 00 00 00 00 00 02 87 01
			15 00 00 00 00 00 02 88 D8
			15 00 00 00 00 00 02 89 01
			15 00 00 00 00 00 02 8A FA
			15 00 00 00 00 00 02 8B 02
			15 00 00 00 00 00 02 8C 32
			15 00 00 00 00 00 02 8D 02
			15 00 00 00 00 00 02 8E 63
			15 00 00 00 00 00 02 8F 02
			15 00 00 00 00 00 02 90 65
			15 00 00 00 00 00 02 91 02
			15 00 00 00 00 00 02 92 94
			15 00 00 00 00 00 02 93 02
			15 00 00 00 00 00 02 94 CD
			15 00 00 00 00 00 02 95 02
			15 00 00 00 00 00 02 96 F2
			15 00 00 00 00 00 02 97 03
			15 00 00 00 00 00 02 98 26
			15 00 00 00 00 00 02 99 03
			15 00 00 00 00 00 02 9A 47
			15 00 00 00 00 00 02 9B 03
			15 00 00 00 00 00 02 9C 6A
			15 00 00 00 00 00 02 9D 03
			15 00 00 00 00 00 02 9E 78
			15 00 00 00 00 00 02 9F 03
			15 00 00 00 00 00 02 A0 81
			15 00 00 00 00 00 02 A2 03
			15 00 00 00 00 00 02 A3 83
			15 00 00 00 00 00 02 A4 03
			15 00 00 00 00 00 02 A5 89
			15 00 00 00 00 00 02 A6 03
			15 00 00 00 00 00 02 A7 8D
			15 00 00 00 00 00 02 A9 03
			15 00 00 00 00 00 02 AA 96
			15 00 00 00 00 00 02 AB 03
			15 00 00 00 00 00 02 AC A3
			15 00 00 00 00 00 02 AD 03
			15 00 00 00 00 00 02 AE B4
			15 00 00 00 00 00 02 AF 01
			15 00 00 00 00 00 02 B0 40
			15 00 00 00 00 00 02 B1 01
			15 00 00 00 00 00 02 B2 45
			15 00 00 00 00 00 02 B3 01
			15 00 00 00 00 00 02 B4 4E
			15 00 00 00 00 00 02 B5 01
			15 00 00 00 00 00 02 B6 58
			15 00 00 00 00 00 02 B7 01
			15 00 00 00 00 00 02 B8 60
			15 00 00 00 00 00 02 B9 01
			15 00 00 00 00 00 02 BA 68
			15 00 00 00 00 00 02 BB 01
			15 00 00 00 00 00 02 BC 70
			15 00 00 00 00 00 02 BD 01
			15 00 00 00 00 00 02 BE 78
			15 00 00 00 00 00 02 BF 01
			15 00 00 00 00 00 02 C0 7F
			15 00 00 00 00 00 02 C1 01
			15 00 00 00 00 00 02 C2 99
			15 00 00 00 00 00 02 C3 01
			15 00 00 00 00 00 02 C4 B0
			15 00 00 00 00 00 02 C5 01
			15 00 00 00 00 00 02 C6 D8
			15 00 00 00 00 00 02 C7 01
			15 00 00 00 00 00 02 C8 FA
			15 00 00 00 00 00 02 C9 02
			15 00 00 00 00 00 02 CA 32
			15 00 00 00 00 00 02 CB 02
			15 00 00 00 00 00 02 CC 63
			15 00 00 00 00 00 02 CD 02
			15 00 00 00 00 00 02 CE 65
			15 00 00 00 00 00 02 CF 02
			15 00 00 00 00 00 02 D0 94
			15 00 00 00 00 00 02 D1 02
			15 00 00 00 00 00 02 D2 CD
			15 00 00 00 00 00 02 D3 02
			15 00 00 00 00 00 02 D4 F2
			15 00 00 00 00 00 02 D5 03
			15 00 00 00 00 00 02 D6 26
			15 00 00 00 00 00 02 D7 03
			15 00 00 00 00 00 02 D8 47
			15 00 00 00 00 00 02 D9 03
			15 00 00 00 00 00 02 DA 6A
			15 00 00 00 00 00 02 DB 03
			15 00 00 00 00 00 02 DC 78
			15 00 00 00 00 00 02 DD 03
			15 00 00 00 00 00 02 DE 81
			15 00 00 00 00 00 02 DF 03
			15 00 00 00 00 00 02 E0 83
			15 00 00 00 00 00 02 E1 03
			15 00 00 00 00 00 02 E2 89
			15 00 00 00 00 00 02 E3 03
			15 00 00 00 00 00 02 E4 8D
			15 00 00 00 00 00 02 E5 03
			15 00 00 00 00 00 02 E6 96
			15 00 00 00 00 00 02 E7 03
			15 00 00 00 00 00 02 E8 A3
			15 00 00 00 00 00 02 E9 03
			15 01 00 00 00 00 02 EA B4

			/* < CE Setting(6) (chose one of the two table) > */
			15 00 00 00 00 00 02 FF 03
			15 00 00 00 00 00 02 FB 01
			15 00 00 00 00 00 02 00 00
			15 00 00 00 00 00 02 01 04
			15 00 00 00 00 00 02 02 08
			15 00 00 00 00 00 02 03 0C
			15 00 00 00 00 00 02 04 10
			15 00 00 00 00 00 02 05 14
			15 00 00 00 00 00 02 06 18
			15 00 00 00 00 00 02 07 20
			15 00 00 00 00 00 02 08 24
			15 00 00 00 00 00 02 09 28
			15 00 00 00 00 00 02 0A 30
			15 00 00 00 00 00 02 0B 38
			15 00 00 00 00 00 02 0C 38
			15 00 00 00 00 00 02 0D 30
			15 00 00 00 00 00 02 0E 28
			15 00 00 00 00 00 02 0F 20
			15 00 00 00 00 00 02 10 10
			15 00 00 00 00 00 02 11 00
			15 00 00 00 00 00 02 12 00
			15 00 00 00 00 00 02 13 00
			15 00 00 00 00 00 02 1A 01
			15 00 00 00 00 00 02 53 00
			15 00 00 00 00 00 02 54 00
			15 00 00 00 00 00 02 55 00
			15 00 00 00 00 00 02 56 00
			15 00 00 00 00 00 02 68 01
			15 00 00 00 00 00 02 14 08
			15 00 00 00 00 00 02 4D 00
			15 00 00 00 00 00 02 58 00
			15 00 00 00 00 00 02 59 00
			15 00 00 00 00 00 02 64 2F
			15 00 00 00 00 00 02 65 06
			15 01 00 00 00 00 02 69 02

			/* <LED PWM Frequence Setting(4) - LED PWM: 21khz */
			15 00 00 00 00 00 02 FF 04
			15 00 00 00 00 00 02 FB 01
			15 00 00 00 00 00 02 07 20
			15 00 00 00 00 00 02 08 04
			15 00 00 00 00 00 02 46 06

			15 01 00 00 00 00 02 13 D3 /* CABC_PWM0[7 : 0]       82.05% */

			/* ESD Solution */
			15 01 00 00 00 00 02 FF FF
			15 01 00 00 00 00 02 FB 01
			15 01 00 00 00 00 02 3F 09

			/* < CABC setting(5) > */
			15 00 00 00 00 00 02 FF 00
			15 00 00 00 00 00 02 36 C0
			15 01 00 00 00 00 02 53 24

			05 01 00 00 78 00 02 11 00
			05 01 00 00 0A 00 02 29 00
		];
		qcom,mdss-dsi-off-command = [
			05 01 00 00 32 00 02 28 00
			05 01 00 00 05 00 02 10 00
		];
		qcom,mdss-dsi-on-command-state = "dsi_lp_mode";
		qcom,mdss-dsi-off-command-state = "dsi_hs_mode";
		qcom,mdss-dsi-h-sync-pulse = <1>;
		qcom,mdss-dsi-traffic-mode = "burst_mode";
		qcom,mdss-dsi-bllp-eof-power-mode;
		qcom,mdss-dsi-bllp-power-mode;
		qcom,mdss-dsi-lane-0-state;
		qcom,mdss-dsi-lane-1-state;
		qcom,mdss-dsi-lane-2-state;
		qcom,mdss-dsi-lane-3-state;
		qcom,mdss-dsi-panel-timings = [73 1A 10 00 3E 40 16 1E 15 03 04 00];
		qcom,mdss-dsi-t-clk-post = <0x04>;
		qcom,mdss-dsi-t-clk-pre = <0x19>;
		qcom,mdss-dsi-bl-min-level = <1>;
		qcom,mdss-dsi-bl-max-level = <255>;
		qcom,mdss-dsi-dma-trigger = "trigger_sw";
		qcom,mdss-dsi-mdp-trigger = "none";
		qcom,mdss-dsi-bl-pmic-control-type = "bl_ctrl_dcs";
		qcom,mdss-dsi-reset-sequence = <0 10>, <1 50>;
		qcom,mdss-pan-physical-width-dimension = <74>;
		qcom,mdss-pan-physical-height-dimension = <132>;

		qcom,mdss-dsi-lp11-init;
		qcom,mdss-dsi-init-delay-us = <20000>;
		qcom,mdss-force-clk-lane-hs = <1>;

		samsung,panel-brightness-cmds = [
			15 01 00 00 05 00 02 51 00
		];
		samsung,panel-cabc-on-cmds = [
			15 01 00 00 05 00 02 55 81
		];
		samsung,panel-cabc-off-cmds = [
			15 01 00 00 05 00 02 55 80
		];
		samsung,panel-cabc-cmds-state = "dsi_hs_mode";
	};
};
